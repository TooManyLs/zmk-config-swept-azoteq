## config/boards/shields/swept/Kconfig.defconfig
```kconfig
# Copyright (c) 2020 The ZMK Contributors
# SPDX-License-Identifier: MIT

if SHIELD_SWEPT_DONGLE

config ZMK_KEYBOARD_NAME
	default "Swept tmls"
	
config ZMK_SPLIT_BLE_ROLE_CENTRAL
	default y
	
config ZMK_USB
	default y

endif

if SHIELD_SWEPT_LEFT || SHIELD_SWEPT_RIGHT || SHIELD_SWEPT_DONGLE 

config ZMK_SPLIT
	default y

config ZMK_BLE
	default y

config I2C
	default y
      
endif
```

## config/boards/shields/swept/Kconfig.shield
```kconfig
# Copyright (c) 2020 The ZMK Contributors
# SPDX-License-Identifier: MIT

config SHIELD_SWEPT_LEFT
	def_bool $(shields_list_contains,swept_left)

config SHIELD_SWEPT_RIGHT
	def_bool $(shields_list_contains,swept_right)

config SHIELD_SWEPT_DONGLE
	def_bool $(shields_list_contains,swept_dongle)
```

## config/west.yml
```yaml
manifest:
  remotes:
    - name: zmkfirmware
      url-base: https://github.com/zmkfirmware
    - name: AYM1607
      url-base: https://github.com/AYM1607
    - name: TooManyLs
      url-base: https://github.com/TooManyLs
  projects:
    - name: zmk
      remote: zmkfirmware
      revision: v0.3
      import: app/west.yml
    - name: zmk-driver-azoteq-iqs5xx
      remote: TooManyLs
      revision: main
  self:
    path: config
```
